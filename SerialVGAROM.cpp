// SerialVGAROM.cpp

// Bit0 = H-RESET (active high)
// Bit1 = V-RESET (active low)
// Bit2 = H-SYNC (active low)
// Bit3 = V-SYNC (active low)
// Bit4 = VISIBLE (active high)
// Bit5 = INTERRUPT

// Visible on screen would be:  %00111110

// A0 is not connected to Video ROM, but uses logic for H-RESET to work correctly.
// Thus every signal is used for 16 pixels, instead of the usual 8.
// Also, every other line is supported in ROM, so every other line is skipped.
// The base amount of VideoROM then is 32KB.
// Extra data should be added in the front, or simply duplicated.

#include <stdio.h>
#include <stdlib.h>
#include <math.h>

const int duplicate = 4; // duplicate 32KB ROM this many times in the .bin file

char B2C(const char *binary)
{
	char value = 0;

	for (int k=0; k<8; k++)
	{
		if (binary[k] == '1') value += pow(2, 7-k);
	}

	return value;
};

bool Inc(unsigned char &pixel)
{
	if (pixel == 0x00) pixel = 0xC0;
	else if (pixel == 0xC0) pixel = 0x30;
	else if (pixel == 0x30) pixel = 0xF0;
	else if (pixel == 0xF0) pixel = 0x0C;
	else if (pixel == 0x0C) pixel = 0xCC;
	else if (pixel == 0xCC) pixel = 0x3C;
	else if (pixel == 0x3C) pixel = 0xFC;
	else if (pixel == 0xFC) pixel = 0x03;
	else if (pixel == 0x03) pixel = 0xC3;
	else if (pixel == 0xC3) pixel = 0x33;
	else if (pixel == 0x33) pixel = 0xF3;
	else if (pixel == 0xF3) pixel = 0x0F;
	else if (pixel == 0x0F) pixel = 0xCF;
	else if (pixel == 0xCF) pixel = 0x3F;
	else if (pixel == 0x3F) pixel = 0xFF;
	else if (pixel == 0xFF)
	{
		pixel = 0x00;
		
		return true;
	}

	return false;
};

char Inv(unsigned char pixel)
{
	return ~pixel;
};

int main()
{
	FILE *output = NULL;

	output = fopen("SerialVGA-VideoROM.bin", "wb");
	if (!output) return 0;

	for (int dup=0; dup<duplicate; dup++)
	{
		for (int twice=0; twice<1; twice++)
		{
			for (int j=0; j<15; j++) // back porch
			{	
				for (int i=0; i<40; i++)
				{
					fprintf(output, "%c", B2C("00001110")); // non-visible
				}
		
				for (int i=0; i<1; i++)
				{
					fprintf(output, "%c", B2C("00001110")); // front porch
				}
	
				for (int i=0; i<6; i++)
				{
					fprintf(output, "%c", B2C("00001010")); // h-sync
				}
			
				for (int i=0; i<2; i++)
				{
					fprintf(output, "%c", B2C("00001110")); // back porch
				}
	
				for (int i=0; i<1; i++)
				{
					fprintf(output, "%c", B2C("00001111")); // back porch with h-reset
				}
			
				for (int i=0; i<14; i++)
				{
					fprintf(output, "%c", B2C("00000000")); // unused
				}
			}
	
			for (int j=0; j<1; j++) // more back porch
			{	
				for (int i=0; i<40; i++)
				{
					fprintf(output, "%c", B2C("00001110")); // non-visible
				}
		
				for (int i=0; i<1; i++)
				{
					fprintf(output, "%c", B2C("00001110")); // front porch
				}
	
				for (int i=0; i<6; i++)
				{
					fprintf(output, "%c", B2C("00001010")); // h-sync
				}
			
				for (int i=0; i<2; i++)
				{
					fprintf(output, "%c", B2C("00001110")); // back porch
				}
	
				for (int i=0; i<1; i++)
				{
					fprintf(output, "%c", B2C("00001111")); // back porch with h-reset
				}
			
				for (int i=0; i<14; i++)
				{
					fprintf(output, "%c", B2C("00000000")); // unused
				}
			}
	
			for (int j=0; j<240; j++) // visible
			{
				for (int i=0; i<40; i++)
				{
					fprintf(output, "%c", B2C("00111110")); // visible
				}
		
				for (int i=0; i<1; i++)
				{
					fprintf(output, "%c", B2C("00101110")); // front porch
				}
	
				for (int i=0; i<6; i++)
				{
					fprintf(output, "%c", B2C("00101010")); // h-sync
				}
			
				for (int i=0; i<2; i++)
				{
					fprintf(output, "%c", B2C("00101110")); // back porch
				}
	
				for (int i=0; i<1; i++)
				{
					fprintf(output, "%c", B2C("00101111")); // back porch with h-reset
				}
		
				for (int i=0; i<14; i++)
				{
					fprintf(output, "%c", B2C("00000000")); // unused
				}
			}
		}

		for (int twice=0; twice<1; twice++)
		{
			for (int j=0; j<5; j++) // front porch
			{
				for (int i=0; i<40; i++)
				{
					fprintf(output, "%c", B2C("00001110")); // non-visible
				}
		
				for (int i=0; i<1; i++)
				{
					fprintf(output, "%c", B2C("00001110")); // front porch
				}
	
				for (int i=0; i<6; i++)
				{
					fprintf(output, "%c", B2C("00001010")); // h-sync
				}
			
				for (int i=0; i<2; i++)
				{
					fprintf(output, "%c", B2C("00001110")); // back porch
				}
	
				for (int i=0; i<1; i++)
				{
					fprintf(output, "%c", B2C("00001111")); // back porch with h-reset
				}
		
				for (int i=0; i<14; i++)
				{
					fprintf(output, "%c", B2C("00000000")); // unused
				}
			}
	
			for (int j=0; j<1; j++) // v-sync
			{
				for (int i=0; i<40; i++)
				{
					fprintf(output, "%c", B2C("00000110")); // non-visible
				}
		
				for (int i=0; i<1; i++)
				{
					fprintf(output, "%c", B2C("00000110")); // front porch
				}
	
				for (int i=0; i<6; i++)
				{
					fprintf(output, "%c", B2C("00000010")); // h-sync
				}
				
				for (int i=0; i<2; i++)
				{
					fprintf(output, "%c", B2C("00000110")); // back porch
				}
	
				for (int i=0; i<1; i++)
				{
					fprintf(output, "%c", B2C("00000111")); // back porch with h-reset
				}
		
				for (int i=0; i<14; i++)
				{
					fprintf(output, "%c", B2C("00000000")); // unused
				}
			}
	
			for (int j=0; j<1; j++) // back porch with v-reset
			{
				for (int i=0; i<40; i++)
				{
					fprintf(output, "%c", B2C("00001110")); // non-visible
				}
			
				for (int i=0; i<1; i++)
				{
					fprintf(output, "%c", B2C("00001110")); // front porch
				}
	
				for (int i=0; i<6; i++)
				{
					fprintf(output, "%c", B2C("00001010")); // h-sync
				}
				
				for (int i=0; i<2; i++)
				{
					fprintf(output, "%c", B2C("00001110")); // back porch
				}
	
				for (int i=0; i<1; i++)
				{
					fprintf(output, "%c", B2C("00001101")); // back porch with h-reset and v-reset
				}
			
				for (int i=0; i<14; i++)
				{
					fprintf(output, "%c", B2C("00000000")); // unused
				}
			}
			
			for (int j=0; j<249; j++) // unused
			{
				for (int i=0; i<64; i++)
				{
					fprintf(output, "%c", B2C("00000000")); // unused
				}
			}
		}
	}

	fclose(output);

	output = NULL;

	output = fopen("SerialVGA-CharROM.bin", "wb");
	if (!output) return 0;

	for (int dup=0; dup<duplicate; dup++)
	{
		for (int bank=0; bank<16; bank++) // 16 banks total
		{
/*
			unsigned char p[4] = { 0x00, 0x00, 0x00, 0x00 };

			for (int i=0; i<256; i++)
			{
				fprintf(output, "%c%c%c%c%c%c%c%c", (char)p[0], (char)p[0], (char)p[0], (char)p[0],
					(char)p[1], (char)p[1], (char)p[1], (char)p[1]);

				if (Inc(p[0]))
				{
					if (Inc(p[1]))
					{
						if (Inc(p[2]))
						{
							if (Inc(p[3]))
							{
							
							}
						}
					}
				}
			}
*/	

			fprintf(output, "%c%c%c%c%c%c%c%c", 0x00,0x00,0x00,0x00,0x00,0x00,0x00,0x00);
			fprintf(output, "%c%c%c%c%c%c%c%c", 0x00,0x00,0x00,0x00,0x00,0x00,0x00,0x00);
			fprintf(output, "%c%c%c%c%c%c%c%c", 0x00,0x00,0x00,0x00,0x00,0x00,0x00,0x00);
			fprintf(output, "%c%c%c%c%c%c%c%c", 0x00,0x00,0x00,0x00,0x00,0x00,0x00,0x00);
			fprintf(output, "%c%c%c%c%c%c%c%c", 0x00,0x00,0x00,0x00,0x00,0x00,0x00,0x00);
			fprintf(output, "%c%c%c%c%c%c%c%c", 0x00,0x00,0x00,0x00,0x00,0x00,0x00,0x00);
			fprintf(output, "%c%c%c%c%c%c%c%c", 0x00,0x00,0x00,0x00,0x00,0x00,0x00,0x00);
			fprintf(output, "%c%c%c%c%c%c%c%c", 0x00,0x00,0x00,0x00,0x00,0x00,0x00,0x00);
			fprintf(output, "%c%c%c%c%c%c%c%c", 0x00,0x00,0x00,0x00,0x00,0x00,0x00,0x00);
			fprintf(output, "%c%c%c%c%c%c%c%c", 0x00,0x00,0x00,0x00,0x00,0x00,0x00,0x00);
			fprintf(output, "%c%c%c%c%c%c%c%c", 0x00,0x00,0x00,0x00,0x00,0x00,0x00,0x00);
			fprintf(output, "%c%c%c%c%c%c%c%c", 0x00,0x00,0x00,0x00,0x00,0x00,0x00,0x00);
			fprintf(output, "%c%c%c%c%c%c%c%c", 0x00,0x00,0x00,0x00,0x00,0x00,0x00,0x00);
			fprintf(output, "%c%c%c%c%c%c%c%c", 0x00,0x00,0x00,0x00,0x00,0x00,0x00,0x00);
			fprintf(output, "%c%c%c%c%c%c%c%c", 0x00,0x00,0x00,0x00,0x00,0x00,0x00,0x00);
			fprintf(output, "%c%c%c%c%c%c%c%c", 0x00,0x00,0x00,0x00,0x00,0x00,0x00,0x00);
			fprintf(output, "%c%c%c%c%c%c%c%c", 0x00,0x00,0x00,0x00,0x00,0x00,0x00,0x00);
			fprintf(output, "%c%c%c%c%c%c%c%c", 0x00,0x00,0x00,0x00,0x00,0x00,0x00,0x00);
			fprintf(output, "%c%c%c%c%c%c%c%c", 0x00,0x00,0x00,0x00,0x00,0x00,0x00,0x00);
			fprintf(output, "%c%c%c%c%c%c%c%c", 0x00,0x00,0x00,0x00,0x00,0x00,0x00,0x00);
			fprintf(output, "%c%c%c%c%c%c%c%c", 0x00,0x00,0x00,0x00,0x00,0x00,0x00,0x00);
			fprintf(output, "%c%c%c%c%c%c%c%c", 0x00,0x00,0x00,0x00,0x00,0x00,0x00,0x00);
			fprintf(output, "%c%c%c%c%c%c%c%c", 0x00,0x00,0x00,0x00,0x00,0x00,0x00,0x00);
			fprintf(output, "%c%c%c%c%c%c%c%c", 0x00,0x00,0x00,0x00,0x00,0x00,0x00,0x00);
			fprintf(output, "%c%c%c%c%c%c%c%c", 0x00,0x00,0x00,0x00,0x00,0x00,0x00,0x00);
			fprintf(output, "%c%c%c%c%c%c%c%c", 0x00,0x00,0x00,0x00,0x00,0x00,0x00,0x00);
			fprintf(output, "%c%c%c%c%c%c%c%c", 0x00,0x00,0x00,0x00,0x00,0x00,0x00,0x00);
			fprintf(output, "%c%c%c%c%c%c%c%c", 0x00,0x00,0x00,0x00,0x00,0x00,0x00,0x00);
			fprintf(output, "%c%c%c%c%c%c%c%c", 0x00,0x00,0x00,0x00,0x00,0x00,0x00,0x00);
			fprintf(output, "%c%c%c%c%c%c%c%c", 0x00,0x00,0x00,0x00,0x00,0x00,0x00,0x00);
			fprintf(output, "%c%c%c%c%c%c%c%c", 0x00,0x00,0x00,0x00,0x00,0x00,0x00,0x00);
			fprintf(output, "%c%c%c%c%c%c%c%c", 0x00,0x00,0x00,0x00,0x00,0x00,0x00,0x00);
			fprintf(output, "%c%c%c%c%c%c%c%c", 0x00,0x00,0x00,0x00,0x00,0x00,0x00,0x00);
			fprintf(output, "%c%c%c%c%c%c%c%c", 0x30,0x78,0x78,0x78,0x30,0x00,0x30,0x00);
			fprintf(output, "%c%c%c%c%c%c%c%c", 0x24,0x48,0x6C,0x6C,0x00,0x00,0x00,0x00);
			fprintf(output, "%c%c%c%c%c%c%c%c", 0x6C,0xFE,0x6C,0x6C,0x6C,0xFE,0x6C,0x00);
			fprintf(output, "%c%c%c%c%c%c%c%c", 0x10,0x7E,0xD0,0x7C,0x16,0xFC,0x10,0x00);
			fprintf(output, "%c%c%c%c%c%c%c%c", 0x42,0xA6,0x4C,0x18,0x34,0x6A,0xC4,0x00);
			fprintf(output, "%c%c%c%c%c%c%c%c", 0x70,0xD8,0x70,0xDA,0xCE,0xC6,0x7C,0x00);
			fprintf(output, "%c%c%c%c%c%c%c%c", 0x30,0x30,0x10,0x20,0x00,0x00,0x00,0x00);
			fprintf(output, "%c%c%c%c%c%c%c%c", 0x1C,0x30,0x60,0x60,0x60,0x30,0x1C,0x00);
			fprintf(output, "%c%c%c%c%c%c%c%c", 0x70,0x18,0x0C,0x0C,0x0C,0x18,0x70,0x00);
			fprintf(output, "%c%c%c%c%c%c%c%c", 0x00,0x00,0x6C,0x38,0x6C,0x00,0x00,0x00);
			fprintf(output, "%c%c%c%c%c%c%c%c", 0x00,0x00,0x10,0x10,0x7C,0x10,0x10,0x00);
			fprintf(output, "%c%c%c%c%c%c%c%c", 0x00,0x00,0x00,0x30,0x30,0x10,0x20,0x00);
			fprintf(output, "%c%c%c%c%c%c%c%c", 0x00,0x00,0x00,0x00,0x7C,0x00,0x00,0x00);
			fprintf(output, "%c%c%c%c%c%c%c%c", 0x00,0x00,0x00,0x00,0x00,0x30,0x30,0x00);
			fprintf(output, "%c%c%c%c%c%c%c%c", 0x04,0x0C,0x18,0x30,0x60,0xC0,0x80,0x00);
			fprintf(output, "%c%c%c%c%c%c%c%c", 0x7C,0xC6,0xCE,0xD6,0xE6,0xC6,0x7C,0x00);
			fprintf(output, "%c%c%c%c%c%c%c%c", 0xF8,0x38,0x38,0x38,0x38,0x38,0xFE,0x00);
			fprintf(output, "%c%c%c%c%c%c%c%c", 0x7C,0xC6,0x0C,0x38,0x60,0xC0,0xFE,0x00);
			fprintf(output, "%c%c%c%c%c%c%c%c", 0x7C,0xC6,0x06,0x3C,0x06,0xC6,0x7C,0x00);
			fprintf(output, "%c%c%c%c%c%c%c%c", 0x1E,0x36,0x66,0xC6,0xFE,0x06,0x06,0x00);
			fprintf(output, "%c%c%c%c%c%c%c%c", 0xFE,0xC0,0xFC,0x06,0x06,0xC6,0x7C,0x00);
			fprintf(output, "%c%c%c%c%c%c%c%c", 0x7C,0xC6,0xC0,0xFC,0xC6,0xC6,0x7C,0x00);
			fprintf(output, "%c%c%c%c%c%c%c%c", 0xFE,0xC6,0x0C,0x18,0x30,0x60,0xC0,0x00);
			fprintf(output, "%c%c%c%c%c%c%c%c", 0x7C,0xC6,0xC6,0x7C,0xC6,0xC6,0x7C,0x00);
			fprintf(output, "%c%c%c%c%c%c%c%c", 0x7C,0xC6,0xC6,0x7E,0x06,0xC6,0x7C,0x00);
			fprintf(output, "%c%c%c%c%c%c%c%c", 0x00,0x30,0x00,0x00,0x00,0x30,0x00,0x00);
			fprintf(output, "%c%c%c%c%c%c%c%c", 0x00,0x30,0x00,0x00,0x30,0x30,0x60,0x00);
			fprintf(output, "%c%c%c%c%c%c%c%c", 0x00,0x00,0x1C,0x38,0x70,0x38,0x1C,0x00);
			fprintf(output, "%c%c%c%c%c%c%c%c", 0x00,0x00,0x00,0x7C,0x00,0x7C,0x00,0x00);
			fprintf(output, "%c%c%c%c%c%c%c%c", 0x00,0x00,0x70,0x38,0x1C,0x38,0x70,0x00);
			fprintf(output, "%c%c%c%c%c%c%c%c", 0x7C,0xC6,0x06,0x3C,0x30,0x00,0x30,0x00);
			fprintf(output, "%c%c%c%c%c%c%c%c", 0x7C,0xC6,0xD6,0xD6,0xDC,0xC0,0x7C,0x00);
			fprintf(output, "%c%c%c%c%c%c%c%c", 0x38,0x6C,0xC6,0xC6,0xFE,0xC6,0xC6,0x00);
			fprintf(output, "%c%c%c%c%c%c%c%c", 0xFC,0xC6,0xC6,0xFC,0xC6,0xC6,0xFC,0x00);
			fprintf(output, "%c%c%c%c%c%c%c%c", 0x7C,0xC6,0xC0,0xC0,0xC0,0xC6,0x7C,0x00);
			fprintf(output, "%c%c%c%c%c%c%c%c", 0xF8,0xCC,0xC6,0xC6,0xC6,0xCC,0xF8,0x00);
			fprintf(output, "%c%c%c%c%c%c%c%c", 0xFE,0xC0,0xC0,0xF8,0xC0,0xC0,0xFE,0x00);
			fprintf(output, "%c%c%c%c%c%c%c%c", 0xFE,0xC0,0xC0,0xF8,0xC0,0xC0,0xC0,0x00);
			fprintf(output, "%c%c%c%c%c%c%c%c", 0x7E,0xC0,0xC0,0xDE,0xC6,0xC6,0x7E,0x00);
			fprintf(output, "%c%c%c%c%c%c%c%c", 0xC6,0xC6,0xC6,0xFE,0xC6,0xC6,0xC6,0x00);
			fprintf(output, "%c%c%c%c%c%c%c%c", 0xFE,0x38,0x38,0x38,0x38,0x38,0xFE,0x00);
			fprintf(output, "%c%c%c%c%c%c%c%c", 0x1E,0x06,0x06,0x06,0xC6,0xC6,0x7C,0x00);
			fprintf(output, "%c%c%c%c%c%c%c%c", 0xC6,0xCC,0xD8,0xF0,0xD8,0xCC,0xC6,0x00);
			fprintf(output, "%c%c%c%c%c%c%c%c", 0xC0,0xC0,0xC0,0xC0,0xC0,0xC0,0xFE,0x00);
			fprintf(output, "%c%c%c%c%c%c%c%c", 0xC6,0xEE,0xFE,0xD6,0xC6,0xC6,0xC6,0x00);
			fprintf(output, "%c%c%c%c%c%c%c%c", 0xC6,0xE6,0xF6,0xDE,0xCE,0xC6,0xC6,0x00);
			fprintf(output, "%c%c%c%c%c%c%c%c", 0x7C,0xC6,0xC6,0xC6,0xC6,0xC6,0x7C,0x00);
			fprintf(output, "%c%c%c%c%c%c%c%c", 0xFC,0xC6,0xC6,0xFC,0xC0,0xC0,0xC0,0x00);
			fprintf(output, "%c%c%c%c%c%c%c%c", 0x7C,0xC6,0xC6,0xC6,0xDE,0xCC,0x7A,0x00);
			fprintf(output, "%c%c%c%c%c%c%c%c", 0xFC,0xC6,0xC6,0xFC,0xD8,0xCC,0xC6,0x00);
			fprintf(output, "%c%c%c%c%c%c%c%c", 0x7C,0xC6,0xC0,0x7C,0x06,0xC6,0x7C,0x00);
			fprintf(output, "%c%c%c%c%c%c%c%c", 0xFE,0x38,0x38,0x38,0x38,0x38,0x38,0x00);
			fprintf(output, "%c%c%c%c%c%c%c%c", 0xC6,0xC6,0xC6,0xC6,0xC6,0xC6,0x7C,0x00);
			fprintf(output, "%c%c%c%c%c%c%c%c", 0xC6,0xC6,0xC6,0xC6,0x6C,0x38,0x10,0x00);
			fprintf(output, "%c%c%c%c%c%c%c%c", 0xC6,0xC6,0xD6,0xFE,0xEE,0xC6,0xC6,0x00);
			fprintf(output, "%c%c%c%c%c%c%c%c", 0xC6,0xEE,0x7C,0x38,0x7C,0xEE,0xC6,0x00);
			fprintf(output, "%c%c%c%c%c%c%c%c", 0xC6,0xC6,0xC6,0x7C,0x38,0x38,0x38,0x00);
			fprintf(output, "%c%c%c%c%c%c%c%c", 0xFE,0x0E,0x1C,0x38,0x70,0xE0,0xFE,0x00);
			fprintf(output, "%c%c%c%c%c%c%c%c", 0x7C,0x60,0x60,0x60,0x60,0x60,0x7C,0x00);
			fprintf(output, "%c%c%c%c%c%c%c%c", 0x40,0x60,0x30,0x18,0x0C,0x06,0x02,0x00);
			fprintf(output, "%c%c%c%c%c%c%c%c", 0x7C,0x0C,0x0C,0x0C,0x0C,0x0C,0x7C,0x00);
			fprintf(output, "%c%c%c%c%c%c%c%c", 0x10,0x38,0x6C,0xC6,0x00,0x00,0x00,0x00);
			fprintf(output, "%c%c%c%c%c%c%c%c", 0x00,0x00,0x00,0x00,0x00,0x00,0xFE,0x00);
			fprintf(output, "%c%c%c%c%c%c%c%c", 0x20,0x10,0x00,0x00,0x00,0x00,0x00,0x00);
			fprintf(output, "%c%c%c%c%c%c%c%c", 0x00,0x00,0x7C,0x06,0x7E,0xC6,0x7E,0x00);
			fprintf(output, "%c%c%c%c%c%c%c%c", 0xC0,0xC0,0xFC,0xC6,0xC6,0xC6,0xFC,0x00);
			fprintf(output, "%c%c%c%c%c%c%c%c", 0x00,0x00,0x7C,0xC6,0xC0,0xC6,0x7C,0x00);
			fprintf(output, "%c%c%c%c%c%c%c%c", 0x06,0x06,0x7E,0xC6,0xC6,0xC6,0x7E,0x00);
			fprintf(output, "%c%c%c%c%c%c%c%c", 0x00,0x00,0x7C,0xC6,0xFE,0xC0,0x7C,0x00);
			fprintf(output, "%c%c%c%c%c%c%c%c", 0x3C,0x30,0xFE,0x30,0x30,0x30,0x30,0x00);
			fprintf(output, "%c%c%c%c%c%c%c%c", 0x00,0x00,0x7E,0xC6,0x7E,0x06,0x7C,0x00);
			fprintf(output, "%c%c%c%c%c%c%c%c", 0xC0,0xC0,0xFC,0xC6,0xC6,0xC6,0xC6,0x00);
			fprintf(output, "%c%c%c%c%c%c%c%c", 0x18,0x00,0x78,0x18,0x18,0x18,0xFE,0x00);
			fprintf(output, "%c%c%c%c%c%c%c%c", 0x06,0x00,0x06,0x06,0x06,0xC6,0x7C,0x00);
			fprintf(output, "%c%c%c%c%c%c%c%c", 0xC0,0xC0,0xC6,0xCC,0xF8,0xCC,0xC6,0x00);
			fprintf(output, "%c%c%c%c%c%c%c%c", 0xC0,0xC0,0xC0,0xC0,0xC0,0x70,0x1E,0x00);
			fprintf(output, "%c%c%c%c%c%c%c%c", 0x00,0x00,0xFC,0xD6,0xD6,0xD6,0xD6,0x00);
			fprintf(output, "%c%c%c%c%c%c%c%c", 0x00,0x00,0xFC,0xC6,0xC6,0xC6,0xC6,0x00);
			fprintf(output, "%c%c%c%c%c%c%c%c", 0x00,0x00,0x7C,0xC6,0xC6,0xC6,0x7C,0x00);
			fprintf(output, "%c%c%c%c%c%c%c%c", 0x00,0x00,0xFC,0xC6,0xFC,0xC0,0xC0,0x00);
			fprintf(output, "%c%c%c%c%c%c%c%c", 0x00,0x00,0x7E,0xC6,0x7E,0x06,0x06,0x00);
			fprintf(output, "%c%c%c%c%c%c%c%c", 0x00,0x00,0xDC,0xE6,0xC0,0xC0,0xC0,0x00);
			fprintf(output, "%c%c%c%c%c%c%c%c", 0x00,0x00,0x7E,0xC0,0xFE,0x06,0xFC,0x00);
			fprintf(output, "%c%c%c%c%c%c%c%c", 0x30,0x30,0xFE,0x30,0x30,0x30,0x3E,0x00);
			fprintf(output, "%c%c%c%c%c%c%c%c", 0x00,0x00,0xC6,0xC6,0xC6,0xC6,0x7C,0x00);
			fprintf(output, "%c%c%c%c%c%c%c%c", 0x00,0x00,0xC6,0xC6,0x6C,0x38,0x10,0x00);
			fprintf(output, "%c%c%c%c%c%c%c%c", 0x00,0x00,0xC6,0xD6,0xD6,0xFE,0x6C,0x00);
			fprintf(output, "%c%c%c%c%c%c%c%c", 0x00,0x00,0xEE,0x7C,0x38,0x7C,0xEE,0x00);
			fprintf(output, "%c%c%c%c%c%c%c%c", 0x00,0x00,0xC6,0xC6,0x6C,0x38,0xF0,0x00);
			fprintf(output, "%c%c%c%c%c%c%c%c", 0x00,0x00,0xFE,0x1C,0x38,0x70,0xFE,0x00);
			fprintf(output, "%c%c%c%c%c%c%c%c", 0x1C,0x30,0x30,0x70,0x30,0x30,0x1C,0x00);
			fprintf(output, "%c%c%c%c%c%c%c%c", 0x30,0x30,0x30,0x30,0x30,0x30,0x30,0x00);
			fprintf(output, "%c%c%c%c%c%c%c%c", 0x70,0x18,0x18,0x1C,0x18,0x18,0x70,0x00);
			fprintf(output, "%c%c%c%c%c%c%c%c", 0x00,0x00,0x00,0x76,0xD6,0xDC,0x00,0x00);
			fprintf(output, "%c%c%c%c%c%c%c%c", 0x00,0x00,0x00,0x00,0x00,0x00,0x00,0x00);

			fprintf(output, "%c%c%c%c%c%c%c%c", Inv(0x00),Inv(0x00),Inv(0x00),Inv(0x00),Inv(0x00),Inv(0x00),Inv(0x00),Inv(0x00));
			fprintf(output, "%c%c%c%c%c%c%c%c", Inv(0x00),Inv(0x00),Inv(0x00),Inv(0x00),Inv(0x00),Inv(0x00),Inv(0x00),Inv(0x00));
			fprintf(output, "%c%c%c%c%c%c%c%c", Inv(0x00),Inv(0x00),Inv(0x00),Inv(0x00),Inv(0x00),Inv(0x00),Inv(0x00),Inv(0x00));
			fprintf(output, "%c%c%c%c%c%c%c%c", Inv(0x00),Inv(0x00),Inv(0x00),Inv(0x00),Inv(0x00),Inv(0x00),Inv(0x00),Inv(0x00));
			fprintf(output, "%c%c%c%c%c%c%c%c", Inv(0x00),Inv(0x00),Inv(0x00),Inv(0x00),Inv(0x00),Inv(0x00),Inv(0x00),Inv(0x00));
			fprintf(output, "%c%c%c%c%c%c%c%c", Inv(0x00),Inv(0x00),Inv(0x00),Inv(0x00),Inv(0x00),Inv(0x00),Inv(0x00),Inv(0x00));
			fprintf(output, "%c%c%c%c%c%c%c%c", Inv(0x00),Inv(0x00),Inv(0x00),Inv(0x00),Inv(0x00),Inv(0x00),Inv(0x00),Inv(0x00));
			fprintf(output, "%c%c%c%c%c%c%c%c", Inv(0x00),Inv(0x00),Inv(0x00),Inv(0x00),Inv(0x00),Inv(0x00),Inv(0x00),Inv(0x00));
			fprintf(output, "%c%c%c%c%c%c%c%c", Inv(0x00),Inv(0x00),Inv(0x00),Inv(0x00),Inv(0x00),Inv(0x00),Inv(0x00),Inv(0x00));
			fprintf(output, "%c%c%c%c%c%c%c%c", Inv(0x00),Inv(0x00),Inv(0x00),Inv(0x00),Inv(0x00),Inv(0x00),Inv(0x00),Inv(0x00));
			fprintf(output, "%c%c%c%c%c%c%c%c", Inv(0x00),Inv(0x00),Inv(0x00),Inv(0x00),Inv(0x00),Inv(0x00),Inv(0x00),Inv(0x00));
			fprintf(output, "%c%c%c%c%c%c%c%c", Inv(0x00),Inv(0x00),Inv(0x00),Inv(0x00),Inv(0x00),Inv(0x00),Inv(0x00),Inv(0x00));
			fprintf(output, "%c%c%c%c%c%c%c%c", Inv(0x00),Inv(0x00),Inv(0x00),Inv(0x00),Inv(0x00),Inv(0x00),Inv(0x00),Inv(0x00));
			fprintf(output, "%c%c%c%c%c%c%c%c", Inv(0x00),Inv(0x00),Inv(0x00),Inv(0x00),Inv(0x00),Inv(0x00),Inv(0x00),Inv(0x00));
			fprintf(output, "%c%c%c%c%c%c%c%c", Inv(0x00),Inv(0x00),Inv(0x00),Inv(0x00),Inv(0x00),Inv(0x00),Inv(0x00),Inv(0x00));
			fprintf(output, "%c%c%c%c%c%c%c%c", Inv(0x00),Inv(0x00),Inv(0x00),Inv(0x00),Inv(0x00),Inv(0x00),Inv(0x00),Inv(0x00));
			fprintf(output, "%c%c%c%c%c%c%c%c", Inv(0x00),Inv(0x00),Inv(0x00),Inv(0x00),Inv(0x00),Inv(0x00),Inv(0x00),Inv(0x00));
			fprintf(output, "%c%c%c%c%c%c%c%c", Inv(0x00),Inv(0x00),Inv(0x00),Inv(0x00),Inv(0x00),Inv(0x00),Inv(0x00),Inv(0x00));
			fprintf(output, "%c%c%c%c%c%c%c%c", Inv(0x00),Inv(0x00),Inv(0x00),Inv(0x00),Inv(0x00),Inv(0x00),Inv(0x00),Inv(0x00));
			fprintf(output, "%c%c%c%c%c%c%c%c", Inv(0x00),Inv(0x00),Inv(0x00),Inv(0x00),Inv(0x00),Inv(0x00),Inv(0x00),Inv(0x00));
			fprintf(output, "%c%c%c%c%c%c%c%c", Inv(0x00),Inv(0x00),Inv(0x00),Inv(0x00),Inv(0x00),Inv(0x00),Inv(0x00),Inv(0x00));
			fprintf(output, "%c%c%c%c%c%c%c%c", Inv(0x00),Inv(0x00),Inv(0x00),Inv(0x00),Inv(0x00),Inv(0x00),Inv(0x00),Inv(0x00));
			fprintf(output, "%c%c%c%c%c%c%c%c", Inv(0x00),Inv(0x00),Inv(0x00),Inv(0x00),Inv(0x00),Inv(0x00),Inv(0x00),Inv(0x00));
			fprintf(output, "%c%c%c%c%c%c%c%c", Inv(0x00),Inv(0x00),Inv(0x00),Inv(0x00),Inv(0x00),Inv(0x00),Inv(0x00),Inv(0x00));
			fprintf(output, "%c%c%c%c%c%c%c%c", Inv(0x00),Inv(0x00),Inv(0x00),Inv(0x00),Inv(0x00),Inv(0x00),Inv(0x00),Inv(0x00));
			fprintf(output, "%c%c%c%c%c%c%c%c", Inv(0x00),Inv(0x00),Inv(0x00),Inv(0x00),Inv(0x00),Inv(0x00),Inv(0x00),Inv(0x00));
			fprintf(output, "%c%c%c%c%c%c%c%c", Inv(0x00),Inv(0x00),Inv(0x00),Inv(0x00),Inv(0x00),Inv(0x00),Inv(0x00),Inv(0x00));
			fprintf(output, "%c%c%c%c%c%c%c%c", Inv(0x00),Inv(0x00),Inv(0x00),Inv(0x00),Inv(0x00),Inv(0x00),Inv(0x00),Inv(0x00));
			fprintf(output, "%c%c%c%c%c%c%c%c", Inv(0x00),Inv(0x00),Inv(0x00),Inv(0x00),Inv(0x00),Inv(0x00),Inv(0x00),Inv(0x00));
			fprintf(output, "%c%c%c%c%c%c%c%c", Inv(0x00),Inv(0x00),Inv(0x00),Inv(0x00),Inv(0x00),Inv(0x00),Inv(0x00),Inv(0x00));
			fprintf(output, "%c%c%c%c%c%c%c%c", Inv(0x00),Inv(0x00),Inv(0x00),Inv(0x00),Inv(0x00),Inv(0x00),Inv(0x00),Inv(0x00));
			fprintf(output, "%c%c%c%c%c%c%c%c", Inv(0x00),Inv(0x00),Inv(0x00),Inv(0x00),Inv(0x00),Inv(0x00),Inv(0x00),Inv(0x00));
			fprintf(output, "%c%c%c%c%c%c%c%c", Inv(0x00),Inv(0x00),Inv(0x00),Inv(0x00),Inv(0x00),Inv(0x00),Inv(0x00),Inv(0x00));
			fprintf(output, "%c%c%c%c%c%c%c%c", Inv(0x30),Inv(0x78),Inv(0x78),Inv(0x78),Inv(0x30),Inv(0x00),Inv(0x30),Inv(0x00));
			fprintf(output, "%c%c%c%c%c%c%c%c", Inv(0x24),Inv(0x48),Inv(0x6C),Inv(0x6C),Inv(0x00),Inv(0x00),Inv(0x00),Inv(0x00));
			fprintf(output, "%c%c%c%c%c%c%c%c", Inv(0x6C),Inv(0xFE),Inv(0x6C),Inv(0x6C),Inv(0x6C),Inv(0xFE),Inv(0x6C),Inv(0x00));
			fprintf(output, "%c%c%c%c%c%c%c%c", Inv(0x10),Inv(0x7E),Inv(0xD0),Inv(0x7C),Inv(0x16),Inv(0xFC),Inv(0x10),Inv(0x00));
			fprintf(output, "%c%c%c%c%c%c%c%c", Inv(0x42),Inv(0xA6),Inv(0x4C),Inv(0x18),Inv(0x34),Inv(0x6A),Inv(0xC4),Inv(0x00));
			fprintf(output, "%c%c%c%c%c%c%c%c", Inv(0x70),Inv(0xD8),Inv(0x70),Inv(0xDA),Inv(0xCE),Inv(0xC6),Inv(0x7C),Inv(0x00));
			fprintf(output, "%c%c%c%c%c%c%c%c", Inv(0x30),Inv(0x30),Inv(0x10),Inv(0x20),Inv(0x00),Inv(0x00),Inv(0x00),Inv(0x00));
			fprintf(output, "%c%c%c%c%c%c%c%c", Inv(0x1C),Inv(0x30),Inv(0x60),Inv(0x60),Inv(0x60),Inv(0x30),Inv(0x1C),Inv(0x00));
			fprintf(output, "%c%c%c%c%c%c%c%c", Inv(0x70),Inv(0x18),Inv(0x0C),Inv(0x0C),Inv(0x0C),Inv(0x18),Inv(0x70),Inv(0x00));
			fprintf(output, "%c%c%c%c%c%c%c%c", Inv(0x00),Inv(0x00),Inv(0x6C),Inv(0x38),Inv(0x6C),Inv(0x00),Inv(0x00),Inv(0x00));
			fprintf(output, "%c%c%c%c%c%c%c%c", Inv(0x00),Inv(0x00),Inv(0x10),Inv(0x10),Inv(0x7C),Inv(0x10),Inv(0x10),Inv(0x00));
			fprintf(output, "%c%c%c%c%c%c%c%c", Inv(0x00),Inv(0x00),Inv(0x00),Inv(0x30),Inv(0x30),Inv(0x10),Inv(0x20),Inv(0x00));
			fprintf(output, "%c%c%c%c%c%c%c%c", Inv(0x00),Inv(0x00),Inv(0x00),Inv(0x00),Inv(0x7C),Inv(0x00),Inv(0x00),Inv(0x00));
			fprintf(output, "%c%c%c%c%c%c%c%c", Inv(0x00),Inv(0x00),Inv(0x00),Inv(0x00),Inv(0x00),Inv(0x30),Inv(0x30),Inv(0x00));
			fprintf(output, "%c%c%c%c%c%c%c%c", Inv(0x04),Inv(0x0C),Inv(0x18),Inv(0x30),Inv(0x60),Inv(0xC0),Inv(0x80),Inv(0x00));
			fprintf(output, "%c%c%c%c%c%c%c%c", Inv(0x7C),Inv(0xC6),Inv(0xCE),Inv(0xD6),Inv(0xE6),Inv(0xC6),Inv(0x7C),Inv(0x00));
			fprintf(output, "%c%c%c%c%c%c%c%c", Inv(0xF8),Inv(0x38),Inv(0x38),Inv(0x38),Inv(0x38),Inv(0x38),Inv(0xFE),Inv(0x00));
			fprintf(output, "%c%c%c%c%c%c%c%c", Inv(0x7C),Inv(0xC6),Inv(0x0C),Inv(0x38),Inv(0x60),Inv(0xC0),Inv(0xFE),Inv(0x00));
			fprintf(output, "%c%c%c%c%c%c%c%c", Inv(0x7C),Inv(0xC6),Inv(0x06),Inv(0x3C),Inv(0x06),Inv(0xC6),Inv(0x7C),Inv(0x00));
			fprintf(output, "%c%c%c%c%c%c%c%c", Inv(0x1E),Inv(0x36),Inv(0x66),Inv(0xC6),Inv(0xFE),Inv(0x06),Inv(0x06),Inv(0x00));
			fprintf(output, "%c%c%c%c%c%c%c%c", Inv(0xFE),Inv(0xC0),Inv(0xFC),Inv(0x06),Inv(0x06),Inv(0xC6),Inv(0x7C),Inv(0x00));
			fprintf(output, "%c%c%c%c%c%c%c%c", Inv(0x7C),Inv(0xC6),Inv(0xC0),Inv(0xFC),Inv(0xC6),Inv(0xC6),Inv(0x7C),Inv(0x00));
			fprintf(output, "%c%c%c%c%c%c%c%c", Inv(0xFE),Inv(0xC6),Inv(0x0C),Inv(0x18),Inv(0x30),Inv(0x60),Inv(0xC0),Inv(0x00));
			fprintf(output, "%c%c%c%c%c%c%c%c", Inv(0x7C),Inv(0xC6),Inv(0xC6),Inv(0x7C),Inv(0xC6),Inv(0xC6),Inv(0x7C),Inv(0x00));
			fprintf(output, "%c%c%c%c%c%c%c%c", Inv(0x7C),Inv(0xC6),Inv(0xC6),Inv(0x7E),Inv(0x06),Inv(0xC6),Inv(0x7C),Inv(0x00));
			fprintf(output, "%c%c%c%c%c%c%c%c", Inv(0x00),Inv(0x30),Inv(0x00),Inv(0x00),Inv(0x00),Inv(0x30),Inv(0x00),Inv(0x00));
			fprintf(output, "%c%c%c%c%c%c%c%c", Inv(0x00),Inv(0x30),Inv(0x00),Inv(0x00),Inv(0x30),Inv(0x30),Inv(0x60),Inv(0x00));
			fprintf(output, "%c%c%c%c%c%c%c%c", Inv(0x00),Inv(0x00),Inv(0x1C),Inv(0x38),Inv(0x70),Inv(0x38),Inv(0x1C),Inv(0x00));
			fprintf(output, "%c%c%c%c%c%c%c%c", Inv(0x00),Inv(0x00),Inv(0x00),Inv(0x7C),Inv(0x00),Inv(0x7C),Inv(0x00),Inv(0x00));
			fprintf(output, "%c%c%c%c%c%c%c%c", Inv(0x00),Inv(0x00),Inv(0x70),Inv(0x38),Inv(0x1C),Inv(0x38),Inv(0x70),Inv(0x00));
			fprintf(output, "%c%c%c%c%c%c%c%c", Inv(0x7C),Inv(0xC6),Inv(0x06),Inv(0x3C),Inv(0x30),Inv(0x00),Inv(0x30),Inv(0x00));
			fprintf(output, "%c%c%c%c%c%c%c%c", Inv(0x7C),Inv(0xC6),Inv(0xD6),Inv(0xD6),Inv(0xDC),Inv(0xC0),Inv(0x7C),Inv(0x00));
			fprintf(output, "%c%c%c%c%c%c%c%c", Inv(0x38),Inv(0x6C),Inv(0xC6),Inv(0xC6),Inv(0xFE),Inv(0xC6),Inv(0xC6),Inv(0x00));
			fprintf(output, "%c%c%c%c%c%c%c%c", Inv(0xFC),Inv(0xC6),Inv(0xC6),Inv(0xFC),Inv(0xC6),Inv(0xC6),Inv(0xFC),Inv(0x00));
			fprintf(output, "%c%c%c%c%c%c%c%c", Inv(0x7C),Inv(0xC6),Inv(0xC0),Inv(0xC0),Inv(0xC0),Inv(0xC6),Inv(0x7C),Inv(0x00));
			fprintf(output, "%c%c%c%c%c%c%c%c", Inv(0xF8),Inv(0xCC),Inv(0xC6),Inv(0xC6),Inv(0xC6),Inv(0xCC),Inv(0xF8),Inv(0x00));
			fprintf(output, "%c%c%c%c%c%c%c%c", Inv(0xFE),Inv(0xC0),Inv(0xC0),Inv(0xF8),Inv(0xC0),Inv(0xC0),Inv(0xFE),Inv(0x00));
			fprintf(output, "%c%c%c%c%c%c%c%c", Inv(0xFE),Inv(0xC0),Inv(0xC0),Inv(0xF8),Inv(0xC0),Inv(0xC0),Inv(0xC0),Inv(0x00));
			fprintf(output, "%c%c%c%c%c%c%c%c", Inv(0x7E),Inv(0xC0),Inv(0xC0),Inv(0xDE),Inv(0xC6),Inv(0xC6),Inv(0x7E),Inv(0x00));
			fprintf(output, "%c%c%c%c%c%c%c%c", Inv(0xC6),Inv(0xC6),Inv(0xC6),Inv(0xFE),Inv(0xC6),Inv(0xC6),Inv(0xC6),Inv(0x00));
			fprintf(output, "%c%c%c%c%c%c%c%c", Inv(0xFE),Inv(0x38),Inv(0x38),Inv(0x38),Inv(0x38),Inv(0x38),Inv(0xFE),Inv(0x00));
			fprintf(output, "%c%c%c%c%c%c%c%c", Inv(0x1E),Inv(0x06),Inv(0x06),Inv(0x06),Inv(0xC6),Inv(0xC6),Inv(0x7C),Inv(0x00));
			fprintf(output, "%c%c%c%c%c%c%c%c", Inv(0xC6),Inv(0xCC),Inv(0xD8),Inv(0xF0),Inv(0xD8),Inv(0xCC),Inv(0xC6),Inv(0x00));
			fprintf(output, "%c%c%c%c%c%c%c%c", Inv(0xC0),Inv(0xC0),Inv(0xC0),Inv(0xC0),Inv(0xC0),Inv(0xC0),Inv(0xFE),Inv(0x00));
			fprintf(output, "%c%c%c%c%c%c%c%c", Inv(0xC6),Inv(0xEE),Inv(0xFE),Inv(0xD6),Inv(0xC6),Inv(0xC6),Inv(0xC6),Inv(0x00));
			fprintf(output, "%c%c%c%c%c%c%c%c", Inv(0xC6),Inv(0xE6),Inv(0xF6),Inv(0xDE),Inv(0xCE),Inv(0xC6),Inv(0xC6),Inv(0x00));
			fprintf(output, "%c%c%c%c%c%c%c%c", Inv(0x7C),Inv(0xC6),Inv(0xC6),Inv(0xC6),Inv(0xC6),Inv(0xC6),Inv(0x7C),Inv(0x00));
			fprintf(output, "%c%c%c%c%c%c%c%c", Inv(0xFC),Inv(0xC6),Inv(0xC6),Inv(0xFC),Inv(0xC0),Inv(0xC0),Inv(0xC0),Inv(0x00));
			fprintf(output, "%c%c%c%c%c%c%c%c", Inv(0x7C),Inv(0xC6),Inv(0xC6),Inv(0xC6),Inv(0xDE),Inv(0xCC),Inv(0x7A),Inv(0x00));
			fprintf(output, "%c%c%c%c%c%c%c%c", Inv(0xFC),Inv(0xC6),Inv(0xC6),Inv(0xFC),Inv(0xD8),Inv(0xCC),Inv(0xC6),Inv(0x00));
			fprintf(output, "%c%c%c%c%c%c%c%c", Inv(0x7C),Inv(0xC6),Inv(0xC0),Inv(0x7C),Inv(0x06),Inv(0xC6),Inv(0x7C),Inv(0x00));
			fprintf(output, "%c%c%c%c%c%c%c%c", Inv(0xFE),Inv(0x38),Inv(0x38),Inv(0x38),Inv(0x38),Inv(0x38),Inv(0x38),Inv(0x00));
			fprintf(output, "%c%c%c%c%c%c%c%c", Inv(0xC6),Inv(0xC6),Inv(0xC6),Inv(0xC6),Inv(0xC6),Inv(0xC6),Inv(0x7C),Inv(0x00));
			fprintf(output, "%c%c%c%c%c%c%c%c", Inv(0xC6),Inv(0xC6),Inv(0xC6),Inv(0xC6),Inv(0x6C),Inv(0x38),Inv(0x10),Inv(0x00));
			fprintf(output, "%c%c%c%c%c%c%c%c", Inv(0xC6),Inv(0xC6),Inv(0xD6),Inv(0xFE),Inv(0xEE),Inv(0xC6),Inv(0xC6),Inv(0x00));
			fprintf(output, "%c%c%c%c%c%c%c%c", Inv(0xC6),Inv(0xEE),Inv(0x7C),Inv(0x38),Inv(0x7C),Inv(0xEE),Inv(0xC6),Inv(0x00));
			fprintf(output, "%c%c%c%c%c%c%c%c", Inv(0xC6),Inv(0xC6),Inv(0xC6),Inv(0x7C),Inv(0x38),Inv(0x38),Inv(0x38),Inv(0x00));
			fprintf(output, "%c%c%c%c%c%c%c%c", Inv(0xFE),Inv(0x0E),Inv(0x1C),Inv(0x38),Inv(0x70),Inv(0xE0),Inv(0xFE),Inv(0x00));
			fprintf(output, "%c%c%c%c%c%c%c%c", Inv(0x7C),Inv(0x60),Inv(0x60),Inv(0x60),Inv(0x60),Inv(0x60),Inv(0x7C),Inv(0x00));
			fprintf(output, "%c%c%c%c%c%c%c%c", Inv(0x40),Inv(0x60),Inv(0x30),Inv(0x18),Inv(0x0C),Inv(0x06),Inv(0x02),Inv(0x00));
			fprintf(output, "%c%c%c%c%c%c%c%c", Inv(0x7C),Inv(0x0C),Inv(0x0C),Inv(0x0C),Inv(0x0C),Inv(0x0C),Inv(0x7C),Inv(0x00));
			fprintf(output, "%c%c%c%c%c%c%c%c", Inv(0x10),Inv(0x38),Inv(0x6C),Inv(0xC6),Inv(0x00),Inv(0x00),Inv(0x00),Inv(0x00));
			fprintf(output, "%c%c%c%c%c%c%c%c", Inv(0x00),Inv(0x00),Inv(0x00),Inv(0x00),Inv(0x00),Inv(0x00),Inv(0xFE),Inv(0x00));
			fprintf(output, "%c%c%c%c%c%c%c%c", Inv(0x20),Inv(0x10),Inv(0x00),Inv(0x00),Inv(0x00),Inv(0x00),Inv(0x00),Inv(0x00));
			fprintf(output, "%c%c%c%c%c%c%c%c", Inv(0x00),Inv(0x00),Inv(0x7C),Inv(0x06),Inv(0x7E),Inv(0xC6),Inv(0x7E),Inv(0x00));
			fprintf(output, "%c%c%c%c%c%c%c%c", Inv(0xC0),Inv(0xC0),Inv(0xFC),Inv(0xC6),Inv(0xC6),Inv(0xC6),Inv(0xFC),Inv(0x00));
			fprintf(output, "%c%c%c%c%c%c%c%c", Inv(0x00),Inv(0x00),Inv(0x7C),Inv(0xC6),Inv(0xC0),Inv(0xC6),Inv(0x7C),Inv(0x00));
			fprintf(output, "%c%c%c%c%c%c%c%c", Inv(0x06),Inv(0x06),Inv(0x7E),Inv(0xC6),Inv(0xC6),Inv(0xC6),Inv(0x7E),Inv(0x00));
			fprintf(output, "%c%c%c%c%c%c%c%c", Inv(0x00),Inv(0x00),Inv(0x7C),Inv(0xC6),Inv(0xFE),Inv(0xC0),Inv(0x7C),Inv(0x00));
			fprintf(output, "%c%c%c%c%c%c%c%c", Inv(0x3C),Inv(0x30),Inv(0xFE),Inv(0x30),Inv(0x30),Inv(0x30),Inv(0x30),Inv(0x00));
			fprintf(output, "%c%c%c%c%c%c%c%c", Inv(0x00),Inv(0x00),Inv(0x7E),Inv(0xC6),Inv(0x7E),Inv(0x06),Inv(0x7C),Inv(0x00));
			fprintf(output, "%c%c%c%c%c%c%c%c", Inv(0xC0),Inv(0xC0),Inv(0xFC),Inv(0xC6),Inv(0xC6),Inv(0xC6),Inv(0xC6),Inv(0x00));
			fprintf(output, "%c%c%c%c%c%c%c%c", Inv(0x18),Inv(0x00),Inv(0x78),Inv(0x18),Inv(0x18),Inv(0x18),Inv(0xFE),Inv(0x00));
			fprintf(output, "%c%c%c%c%c%c%c%c", Inv(0x06),Inv(0x00),Inv(0x06),Inv(0x06),Inv(0x06),Inv(0xC6),Inv(0x7C),Inv(0x00));
			fprintf(output, "%c%c%c%c%c%c%c%c", Inv(0xC0),Inv(0xC0),Inv(0xC6),Inv(0xCC),Inv(0xF8),Inv(0xCC),Inv(0xC6),Inv(0x00));
			fprintf(output, "%c%c%c%c%c%c%c%c", Inv(0xC0),Inv(0xC0),Inv(0xC0),Inv(0xC0),Inv(0xC0),Inv(0x70),Inv(0x1E),Inv(0x00));
			fprintf(output, "%c%c%c%c%c%c%c%c", Inv(0x00),Inv(0x00),Inv(0xFC),Inv(0xD6),Inv(0xD6),Inv(0xD6),Inv(0xD6),Inv(0x00));
			fprintf(output, "%c%c%c%c%c%c%c%c", Inv(0x00),Inv(0x00),Inv(0xFC),Inv(0xC6),Inv(0xC6),Inv(0xC6),Inv(0xC6),Inv(0x00));
			fprintf(output, "%c%c%c%c%c%c%c%c", Inv(0x00),Inv(0x00),Inv(0x7C),Inv(0xC6),Inv(0xC6),Inv(0xC6),Inv(0x7C),Inv(0x00));
			fprintf(output, "%c%c%c%c%c%c%c%c", Inv(0x00),Inv(0x00),Inv(0xFC),Inv(0xC6),Inv(0xFC),Inv(0xC0),Inv(0xC0),Inv(0x00));
			fprintf(output, "%c%c%c%c%c%c%c%c", Inv(0x00),Inv(0x00),Inv(0x7E),Inv(0xC6),Inv(0x7E),Inv(0x06),Inv(0x06),Inv(0x00));
			fprintf(output, "%c%c%c%c%c%c%c%c", Inv(0x00),Inv(0x00),Inv(0xDC),Inv(0xE6),Inv(0xC0),Inv(0xC0),Inv(0xC0),Inv(0x00));
			fprintf(output, "%c%c%c%c%c%c%c%c", Inv(0x00),Inv(0x00),Inv(0x7E),Inv(0xC0),Inv(0xFE),Inv(0x06),Inv(0xFC),Inv(0x00));
			fprintf(output, "%c%c%c%c%c%c%c%c", Inv(0x30),Inv(0x30),Inv(0xFE),Inv(0x30),Inv(0x30),Inv(0x30),Inv(0x3E),Inv(0x00));
			fprintf(output, "%c%c%c%c%c%c%c%c", Inv(0x00),Inv(0x00),Inv(0xC6),Inv(0xC6),Inv(0xC6),Inv(0xC6),Inv(0x7C),Inv(0x00));
			fprintf(output, "%c%c%c%c%c%c%c%c", Inv(0x00),Inv(0x00),Inv(0xC6),Inv(0xC6),Inv(0x6C),Inv(0x38),Inv(0x10),Inv(0x00));
			fprintf(output, "%c%c%c%c%c%c%c%c", Inv(0x00),Inv(0x00),Inv(0xC6),Inv(0xD6),Inv(0xD6),Inv(0xFE),Inv(0x6C),Inv(0x00));
			fprintf(output, "%c%c%c%c%c%c%c%c", Inv(0x00),Inv(0x00),Inv(0xEE),Inv(0x7C),Inv(0x38),Inv(0x7C),Inv(0xEE),Inv(0x00));
			fprintf(output, "%c%c%c%c%c%c%c%c", Inv(0x00),Inv(0x00),Inv(0xC6),Inv(0xC6),Inv(0x6C),Inv(0x38),Inv(0xF0),Inv(0x00));
			fprintf(output, "%c%c%c%c%c%c%c%c", Inv(0x00),Inv(0x00),Inv(0xFE),Inv(0x1C),Inv(0x38),Inv(0x70),Inv(0xFE),Inv(0x00));
			fprintf(output, "%c%c%c%c%c%c%c%c", Inv(0x1C),Inv(0x30),Inv(0x30),Inv(0x70),Inv(0x30),Inv(0x30),Inv(0x1C),Inv(0x00));
			fprintf(output, "%c%c%c%c%c%c%c%c", Inv(0x30),Inv(0x30),Inv(0x30),Inv(0x30),Inv(0x30),Inv(0x30),Inv(0x30),Inv(0x00));
			fprintf(output, "%c%c%c%c%c%c%c%c", Inv(0x70),Inv(0x18),Inv(0x18),Inv(0x1C),Inv(0x18),Inv(0x18),Inv(0x70),Inv(0x00));
			fprintf(output, "%c%c%c%c%c%c%c%c", Inv(0x00),Inv(0x00),Inv(0x00),Inv(0x76),Inv(0xD6),Inv(0xDC),Inv(0x00),Inv(0x00));
			fprintf(output, "%c%c%c%c%c%c%c%c", Inv(0x00),Inv(0x00),Inv(0x00),Inv(0x00),Inv(0x00),Inv(0x00),Inv(0x00),Inv(0x00));
		}
	}

	fclose(output);

	return 1;
}



/*
				for (int i=0; i<32; i++) // control characters
				{
					fprintf(output, "%c", B2C("00000000"));
					fprintf(output, "%c", B2C("00000000"));
					fprintf(output, "%c", B2C("00000000"));
					fprintf(output, "%c", B2C("00000000"));
					fprintf(output, "%c", B2C("00000000"));
					fprintf(output, "%c", B2C("00000000"));
					fprintf(output, "%c", B2C("00000000"));

					fprintf(output, "%c", B2C("00000000"));
				}

				for (int i=0; i<(128-32)/16; i++) // (replacement) ascii characters
				{
					// 0
					fprintf(output, "%c", B2C("11111110"));
					fprintf(output, "%c", B2C("10000010"));
					fprintf(output, "%c", B2C("10000010"));
					fprintf(output, "%c", B2C("10000010"));
					fprintf(output, "%c", B2C("10000010"));
					fprintf(output, "%c", B2C("10000010"));
					fprintf(output, "%c", B2C("11111110"));
					fprintf(output, "%c", B2C("00000000"));

					// 1
					fprintf(output, "%c", B2C("00000010"));
					fprintf(output, "%c", B2C("00000010"));
					fprintf(output, "%c", B2C("00000010"));
					fprintf(output, "%c", B2C("00000010"));
					fprintf(output, "%c", B2C("00000010"));
					fprintf(output, "%c", B2C("00000010"));
					fprintf(output, "%c", B2C("00000010"));
					fprintf(output, "%c", B2C("00000000"));
				
					// 2
					fprintf(output, "%c", B2C("11111110"));
					fprintf(output, "%c", B2C("00000010"));
					fprintf(output, "%c", B2C("00000010"));
					fprintf(output, "%c", B2C("11111110"));
					fprintf(output, "%c", B2C("10000000"));
					fprintf(output, "%c", B2C("10000000"));
					fprintf(output, "%c", B2C("11111110"));
					fprintf(output, "%c", B2C("00000000"));

					// 3
					fprintf(output, "%c", B2C("11111110"));
					fprintf(output, "%c", B2C("00000010"));
					fprintf(output, "%c", B2C("00000010"));
					fprintf(output, "%c", B2C("11111110"));
					fprintf(output, "%c", B2C("00000010"));
					fprintf(output, "%c", B2C("00000010"));
					fprintf(output, "%c", B2C("11111110"));
					fprintf(output, "%c", B2C("00000000"));

					// 4
					fprintf(output, "%c", B2C("10000010"));
					fprintf(output, "%c", B2C("10000010"));
					fprintf(output, "%c", B2C("10000010"));
					fprintf(output, "%c", B2C("11111110"));
					fprintf(output, "%c", B2C("00000010"));
					fprintf(output, "%c", B2C("00000010"));
					fprintf(output, "%c", B2C("00000010"));
					fprintf(output, "%c", B2C("00000000"));

					// 5
					fprintf(output, "%c", B2C("11111110"));
					fprintf(output, "%c", B2C("10000000"));
					fprintf(output, "%c", B2C("10000000"));
					fprintf(output, "%c", B2C("11111110"));
					fprintf(output, "%c", B2C("00000010"));
					fprintf(output, "%c", B2C("00000010"));
					fprintf(output, "%c", B2C("11111110"));
					fprintf(output, "%c", B2C("00000000"));

					// 6
					fprintf(output, "%c", B2C("11111110"));
					fprintf(output, "%c", B2C("10000000"));
					fprintf(output, "%c", B2C("10000000"));
					fprintf(output, "%c", B2C("11111110"));
					fprintf(output, "%c", B2C("10000010"));
					fprintf(output, "%c", B2C("10000010"));
					fprintf(output, "%c", B2C("11111110"));
					fprintf(output, "%c", B2C("00000000"));

					// 7
					fprintf(output, "%c", B2C("11111110"));
					fprintf(output, "%c", B2C("00000010"));
					fprintf(output, "%c", B2C("00000010"));
					fprintf(output, "%c", B2C("00000010"));
					fprintf(output, "%c", B2C("00000010"));
					fprintf(output, "%c", B2C("00000010"));
					fprintf(output, "%c", B2C("00000010"));
					fprintf(output, "%c", B2C("00000000"));

					// 8
					fprintf(output, "%c", B2C("11111110"));
					fprintf(output, "%c", B2C("10000010"));
					fprintf(output, "%c", B2C("10000010"));
					fprintf(output, "%c", B2C("11111110"));
					fprintf(output, "%c", B2C("10000010"));
					fprintf(output, "%c", B2C("10000010"));
					fprintf(output, "%c", B2C("11111110"));
					fprintf(output, "%c", B2C("00000000"));

					// 9
					fprintf(output, "%c", B2C("11111110"));
					fprintf(output, "%c", B2C("10000010"));
					fprintf(output, "%c", B2C("10000010"));
					fprintf(output, "%c", B2C("11111110"));
					fprintf(output, "%c", B2C("00000010"));
					fprintf(output, "%c", B2C("00000010"));
					fprintf(output, "%c", B2C("11111110"));
					fprintf(output, "%c", B2C("00000000"));

					// A
					fprintf(output, "%c", B2C("11111110"));
					fprintf(output, "%c", B2C("10000010"));
					fprintf(output, "%c", B2C("10000010"));
					fprintf(output, "%c", B2C("11111110"));
					fprintf(output, "%c", B2C("10000010"));
					fprintf(output, "%c", B2C("10000010"));
					fprintf(output, "%c", B2C("10000010"));
					fprintf(output, "%c", B2C("00000000"));

					// B
					fprintf(output, "%c", B2C("10000000"));
					fprintf(output, "%c", B2C("10000000"));
					fprintf(output, "%c", B2C("10000000"));
					fprintf(output, "%c", B2C("11111110"));
					fprintf(output, "%c", B2C("10000010"));
					fprintf(output, "%c", B2C("10000010"));
					fprintf(output, "%c", B2C("11111110"));
					fprintf(output, "%c", B2C("00000000"));

					// C
					fprintf(output, "%c", B2C("11111110"));
					fprintf(output, "%c", B2C("10000000"));
					fprintf(output, "%c", B2C("10000000"));
					fprintf(output, "%c", B2C("10000000"));
					fprintf(output, "%c", B2C("10000000"));
					fprintf(output, "%c", B2C("10000000"));
					fprintf(output, "%c", B2C("11111110"));
					fprintf(output, "%c", B2C("00000000"));

					// D
					fprintf(output, "%c", B2C("00000010"));
					fprintf(output, "%c", B2C("00000010"));
					fprintf(output, "%c", B2C("00000010"));
					fprintf(output, "%c", B2C("11111110"));
					fprintf(output, "%c", B2C("10000010"));
					fprintf(output, "%c", B2C("10000010"));
					fprintf(output, "%c", B2C("11111110"));
					fprintf(output, "%c", B2C("00000000"));

					// E
					fprintf(output, "%c", B2C("11111110"));
					fprintf(output, "%c", B2C("10000000"));
					fprintf(output, "%c", B2C("10000000"));
					fprintf(output, "%c", B2C("11111110"));
					fprintf(output, "%c", B2C("10000000"));
					fprintf(output, "%c", B2C("10000000"));
					fprintf(output, "%c", B2C("11111110"));
					fprintf(output, "%c", B2C("00000000"));

					// F
					fprintf(output, "%c", B2C("11111110"));
					fprintf(output, "%c", B2C("10000000"));
					fprintf(output, "%c", B2C("10000000"));
					fprintf(output, "%c", B2C("11111110"));
					fprintf(output, "%c", B2C("10000000"));
					fprintf(output, "%c", B2C("10000000"));
					fprintf(output, "%c", B2C("10000000"));
					fprintf(output, "%c", B2C("00000000"));

				}
*/


/*
; Assembly Example when connecting
; VCLK = PA0
; VDAT = PA1

via_pa		.EQU $BF01
via_da		.EQU $BF03

test
	JSR sendchar_init

	LDY #$84
	LDX #$04
	LDA #"A"
	JSR sendchar
inf
	JMP inf

; character to be sent is already in A
; and the address is located in X (lower) and Y (higher)
; thus, the letter A ($41 in ASCII) in the top-left corner would be
; Y = %10000000, X = %00000000, A = %01000001
; must have a 1 for the very highest address location, always.
; this assumes via has already been set up with PA0 and PA1 both output low.
sendchar
	PHA
	PHX
	TYA
	LDX #$08
sendchar_loop1
	JSR sendchar_bit
	DEX
	BNE sendchar_loop1
	PLA
	PHA
	LDX #$08
sendchar_loop2
	JSR sendchar_bit
	DEX
	BNE sendchar_loop2
	PLX
	PLA
	PHA
	PHX
	LDX #$08
sendchar_loop3
	JSR sendchar_bit
	DEX
	BNE sendchar_loop3
	PLX
	PLA
	RTS ; exit
sendchar_bit
	ROL A
	PHA
	LDA via_pa
	AND #%11111100
	BCC sendchar_toggle
	ORA #%00000010
sendchar_toggle
	STA via_pa
	INC A
	STA via_pa
	DEC A
	STA via_pa
	PLA
	RTS
sendchar_init ; initializes via
	PHA
	LDA via_da
	ORA #%00000011
	STA via_da
	LDA via_pa
	AND #%11111100
	STA via_pa
	PLA
	RTS



*/


